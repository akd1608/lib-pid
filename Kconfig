## lib/pid/Kconfig
```kconfig
# Copyright (c) 2021, Legrand North America, LLC.
# SPDX-License-Identifier: Apache-2.0

config PID_CONTROLLER
	bool "pid controller Support"
	help
	  This option enables the pid controller library

if PID_CONTROLLER

config PID_CONTROLLING_TIME_DEFAULT
	int "default controlling time"
	default 100
	help
	  set default controlling time for calculation new controling value

config PID_CONTROLLER_FLUSH_BY_NEW_SETPOINT
	bool "deactivate memory for action inbetween setpoints"

config PID_FILTER_COEFFICIENT_ALPHA
	int "weight of the newest derivative step, multiply by 1000"
	default 1000
	range 0 1000
	help
	  Classic form only.  1000 uses the newest step alone, smaller values
	  mix in the step before and smooth the derivative.

config PID_FILTER_CONSTRAIN_SUM
	int "number for constrain integration sum multiply by 1000"
	default 1000000

config PID_SAMPLE_GAP_FACTOR
	int "pause, in regular steps, that counts as one step only"
	default 10
	range 2 1000
	help
	  If pid_run() was not called for longer than this many regular steps,
	  the pause counts as one regular step.  A pause while the output is
	  off therefore does not end up in the integral.

endif # PID_CONTROLLER
```
